## base_external/package/aesd-assignments/Config.in
```kconfig
config BR2_PACKAGE_AESD_ASSIGNMENTS
	bool "aesd-assignments"
	help
	  Includes the aesdsocket executable and aesdsocket-start-stop used for
	  configuring and running a simple socket server on the target.
```

## base_external/package/ldd/Config.in
```kconfig
config BR2_PACKAGE_LDD
	bool "ldd"
	help
	  Custom copy of the ldd3 repo which provides the scull and misc-modules components.
```
